#include "expression_engine.h"
#include "expression_types.h"
#include "expression_assets.h"
#include "ili9341_fsmc.h"
#include "stm32f1xx_hal.h"

/*
 * Expression engine: manages expression display and animation.
 * Assets generated by tools/make_assets.py.
 * Frame size defined by EMO_FRAME_SIZE in expression_assets.h.
 */

static Expression  current_emo;
static uint8_t     current_frame;
static uint32_t    last_frame_tick;
static uint8_t     dirty;

void Expression_Init(void) {
    current_emo    = EMO_NORMAL;
    current_frame  = 0;
    last_frame_tick = 0;
    dirty           = 1;
}

void Expression_Set(Expression emo) {
    if (emo >= EMO_COUNT) return;

    current_emo   = emo;
    current_frame = 0;
    dirty         = 1;
    last_frame_tick = HAL_GetTick();

    /* Clear screen for new expression */
    ILI9341_FillScreen(COLOR_BLACK);
}

Expression Expression_Get(void) {
    return current_emo;
}

void Expression_ForceRedraw(void) {
    dirty = 1;
}

#define EXPR_SCALE  2  /* runtime nearest-neighbor 2x scale */

void Expression_Tick(void) {
    uint32_t now = HAL_GetTick();

    /* Animation: advance frame if animated */
    uint16_t interval = emo_anim_ms[current_emo];
    uint8_t  nframes  = emo_frame_count[current_emo];
    if (nframes > 1 && interval > 0) {
        if (now - last_frame_tick >= interval) {
            current_frame = (current_frame + 1) % nframes;
            last_frame_tick = now;
            dirty = 1;
        }
    }

    /* Redraw */
    if (dirty) {
        const uint16_t *bitmap = emo_frames[current_emo][current_frame];
        if (bitmap) {
            uint16_t sw = EMO_FRAME_SIZE * EXPR_SCALE;
            uint16_t sh = EMO_FRAME_SIZE * EXPR_SCALE;
            uint16_t x = (ILI9341_WIDTH  - sw) / 2;
            uint16_t y = (ILI9341_HEIGHT - sh) / 2;
            ILI9341_DrawBitmapScaled(x, y, EMO_FRAME_SIZE, EMO_FRAME_SIZE,
                                     bitmap, EXPR_SCALE);
        }
        dirty = 0;
    }
}
